## boards/shields/mykeeb/Kconfig.defconfig
```kconfig
if SHIELD_MYKEEB

config ZMK_KEYBOARD_NAME
    default "baubas keeb"

config EC11
    default y

config ZMK_KSCAN_DEBOUNCE_PRESS_MS
    default 5

config ZMK_KSCAN_DEBOUNCE_RELEASE_MS
    default 5

config SPI
    default y

config ZMK_STUDIO
    default y

# config ZMK_PM_SOFT_OFF
#     default y

# config ZMK_SLEEP
#     default y

# config BT_CTLR
# 	default BT

# config ZMK_BLE
# 	default y

# config ZMK_USB
# 	default y

# config ZMK_BATTERY_VOLTAGE_DIVIDER
# 	default y

endif
```

## boards/shields/sofle_half/Kconfig.defconfig
```kconfig
if SHIELD_SOFLE_HALF

config ZMK_KEYBOARD_NAME
    default "Sofle Half"

if ZMK_RGB_UNDERGLOW

config WS2812_STRIP
    default y
endif

endif
```
